## meta-fulan/conf/machine/spark.conf
```bitbake
require conf/machine/include/fulan-oem.inc

SOC_FAMILY = "sti7111"

MACHINE_ESSENTIAL_EXTRA_RDEPENDS += "\
	stlinux24-sh4-stmfb-firmware-stx7111 \
"

MACHINE_FEATURES += "hdmicec ci directfb sh4booster spark textlcd 7segment"
```

## meta-fulan/conf/machine/spark7162.conf
```bitbake
require conf/machine/include/fulan-oem.inc

SOC_FAMILY = "sti7162"
MACHINE_EXTRA_RRECOMMENDS += "\
    enigma2-plugin-systemplugins-sparkuniontunertype \
"

MACHINE_ESSENTIAL_EXTRA_RDEPENDS += "\
    stlinux24-sh4-stmfb-firmware-stx7105 \
    vfdctl \
"

MACHINE_FEATURES += "tripletuner spark7162"
```

## meta-openpli/conf/layer.conf
```bitbake
# We have a conf and classes directory, append to BBPATH
BBPATH .= ":${LAYERDIR}"

# We have a recipes directory, add to BBFILES
BBFILES += "${LAYERDIR}/recipes-*/*.bb ${LAYERDIR}/recipes-*/*.bbappend \
            ${LAYERDIR}/recipes-*/*/*.bb ${LAYERDIR}/recipes-*/*/*.bbappend \
            ${LAYERDIR}/recipes-*/*/*/*.bb ${LAYERDIR}/recipes-*/*/*/*.bbappend"

BBFILE_COLLECTIONS += "meta-openpli-layer"
BBFILE_PATTERN_meta-openpli-layer := "^${LAYERDIR}/"
BBFILE_PRIORITY_meta-openpli-layer = "7"

OPENPLI_BASE := '${@os.path.normpath("${LAYERDIR}/../")}'
# Prevent current directory creeping into sstate objects. Otherwise, building
# in another TOPDIR will cause recipes using this variable to be rebuilt.
OPENPLI_BASE[vardepvalue] = 'meta-openpli'

LICENSE_PATH += "${LAYERDIR}/licenses"

INSANE_SKIP_${PN} += "already-stripped"

DEFAULT_TIMEZONE ?= "GMT"

LAYERSERIES_COMPAT_local-layer = "dunfell"
LAYERSERIES_COMPAT_meta-python = "dunfell"
LAYERSERIES_COMPAT_openembedded-layer = "dunfell"
LAYERSERIES_COMPAT_meta-openpli-layer = "dunfell"

# This prevents bitbake to fail at do_package caused by default OE-core split style variable setting
PACKAGE_DEBUG_SPLIT_STYLE = "debug-without-src"
```
